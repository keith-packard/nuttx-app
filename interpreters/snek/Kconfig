## interpreters/snek/Kconfig
```kconfig
#
# For a description of the syntax of this configuration file,
# see the file kconfig-language.txt in the NuttX tools repository.
#

config INTERPRETERS_SNEK
	bool "Snek Interpreter support"
	default n
	select LIBC_FLOATINGPOINT
	---help---
		This is a small Python-like interpreter written by Keith Packard

		NOTE: This interpreter requires a usable math.h header file.  By
		default, the math library (and hence, math.h) are not provided by
		NuttX.  Therefore, when the Snek code includes math.h it will
		either fail to find the math.h header file or, worse, will take an
		incompatible version of math.h from your toolchain.  The toolchain's
		version of math.h will be incompatible because it will have been
		implemented to work with a different version of the C library.

		Normally, developers will use an optimized math library for their
		processor architecture and do the following:

		- Save a customized copy of math.h from your tool chain in
		  nuttx/arch/<arch>/include
		- Set CONFIG_ARCH_MATH_H=y in your .config file to select this
		  architecture-specific math.h header file.

		An option is to use the built-in, generic, unoptimized NuttX math
		library that is selected by simply by:

		- Set CONFIG_LIBM=y in your .config file

if INTERPRETERS_SNEK

config INTERPRETER_SNEK_PRIORITY
	int "Snek interpreter priority"
	default 100
	---help---
		Task priority of the Snek interpreter main task

config INTERPRETER_SNEK_STACKSIZE
	int "Snek interpreter stack size"
	default 4096
	---help---
		Size of the stack allocated for the Snek interpreter main task

config INTERPRETER_SNEK_HEAPSIZE
	int "Snek interpreter heap size"
	default 16384
	---help---
		Size of the heap allocated for the Snek interpreter

endif
```
